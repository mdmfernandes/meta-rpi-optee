## conf/layer.conf
```bitbake
# We have a conf and classes directory, add to BBPATH
BBPATH .= ":${LAYERDIR}"

# We have recipes-* directories, add to BBFILES
BBFILES += "${LAYERDIR}/recipes-*/*/*.bb \
            ${LAYERDIR}/recipes-*/*/*.bbappend"

BBFILE_COLLECTIONS += "rpi-optee"
BBFILE_PATTERN_rpi-optee = "^${LAYERDIR}/"
BBFILE_PRIORITY_rpi-optee = "9"

LAYERVERSION_rpi-optee = "1"

LAYERDEPENDS_rpi-optee = " \
    core \
    meta-arm \
    raspberrypi \
    "

LAYERSERIES_COMPAT_rpi-optee = "kirkstone"
```

## conf/machine/raspberrypi4-64-optee.conf
```bitbake
#@TYPE: Machine
#@NAME: RaspberryPi 4 Development Board (64bit) with OPTEE
#@DESCRIPTION: Machine configuration for the RaspberryPi 4 in 64 bits mode, with OPTEE

# Add raspberrypi4-64 to the overrides list, for recipes compatible with raspberrypi4-64
# being processed for our machine as well.
MACHINEOVERRIDES =. "raspberrypi4:raspberrypi4-64:"

# Our target inherits the settings from raspberrypi4-64
require conf/machine/raspberrypi4-64.conf

# ATF
PREFERRED_VERSION_trusted-firmware-a = "2.7"
# We need ATF binary to be in the BOOT image
do_image_wic[depends] += " trusted-firmware-a:do_deploy"

# Kernel
PREFERRED_VERSION_linux-raspberrypi = "6.1.%"
# We need to fix the device tree to access the OPTEE
RPI_KERNEL_DEVICETREE_OVERLAYS:append = " overlays/optee-fix.dtbo"

# Enable UART
ENABLE_UART = "1"

# Extra options to pass to config.txt
RPI_EXTRA_CONFIG:append = "\n\
# Enable UART0 for the 2nd stage bootloader\n\
uart_2ndstage=1\n\n\
# Loads at 0x00 and executes it in EL3 in AArch64\n\
armstub=bl31-optee.bin\n\n\
# Device tree fix for OPTEE\n\
dtoverlay=optee-fix\n\n\
# The kernel address \n\
kernel_address=0x200000\n\n\
# Device Tree address\n\
device_tree_address=0x2bd00f00\n\n\
# Device Tree end (64 KB)\n\
device_tree_end=0x2bd10f00\n\
"
```
